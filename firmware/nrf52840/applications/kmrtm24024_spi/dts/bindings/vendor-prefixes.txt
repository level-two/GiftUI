## scripts/nrf52840/west.yml
```yaml
manifest:
  remotes:
    - name: zephyrproject-rtos
      url-base: https://github.com/zephyrproject-rtos
  projects:
    - name: zephyr
      remote: zephyrproject-rtos
      revision: 3568e1b6d5cdd51a6b964a2a1d6d29200fea2056
      import:
        name-allowlist:
          - cmsis
          - cmsis_6
          - hal_nordic
          - segger
  self:
    path: manifest
```
